## config/boards/shields/typhon/Kconfig.defconfig
```kconfig
if SHIELD_TYPHON_LEFT || SHIELD_TYPHON_RIGHT

config ZMK_KEYBOARD_NAME
    default "Typhon"

# This ensures the Bluetooth HID (Keyboard) service is active
config ZMK_BLE
    default y

config ZMK_SPLIT
    default y

endif

if SHIELD_TYPHON_LEFT
config ZMK_SPLIT_ROLE_CENTRAL
    default y
endif
```

## config/west.yml
```yaml
manifest:
  remotes:
    - name: zmkfirmware
      url-base: https://github.com/zmkfirmware
  projects:
    - name: zmk
      remote: zmkfirmware
      revision: main
      import: app/west.yml # THIS IS THE CRUCIAL LINE
  self:
    path: config
```
